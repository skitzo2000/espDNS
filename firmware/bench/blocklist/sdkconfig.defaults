## firmware/bench/blocklist/sdkconfig.defaults
```kconfig
CONFIG_PARTITION_TABLE_CUSTOM=y
CONFIG_PARTITION_TABLE_CUSTOM_FILENAME="partitions.csv"
CONFIG_ESPTOOLPY_FLASHSIZE_8MB=y
CONFIG_ESP_MAIN_TASK_STACK_SIZE=16384
CONFIG_ESP_TASK_WDT_EN=n
CONFIG_SPIRAM_USE_MALLOC=y
CONFIG_COMPILER_OPTIMIZATION_PERF=y
```

## firmware/images/esp32s3-quad/sdkconfig.defaults
```kconfig
# ESP32-S3 with quad PSRAM.
CONFIG_IDF_TARGET="esp32s3"
CONFIG_ESP_DEFAULT_CPU_FREQ_MHZ_240=y
CONFIG_SPIRAM=y
CONFIG_SPIRAM_MODE_QUAD=y
CONFIG_SPIRAM_IGNORE_NOTFOUND=y
```
